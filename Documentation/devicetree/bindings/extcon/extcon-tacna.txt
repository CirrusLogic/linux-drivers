## Documentation/devicetree/bindings/power/supply/ln8411.yaml
```yaml
# SPDX-License-Identifier: (GPL-2.0-only or BSD-2-Clause)
# Copyright (C) 2022 Cirrus Logic, Inc.
%YAML 1.2
---
$id: "http://devicetree.org/schemas/power/supply/ln8411.yaml#"
$schema: "http://devicetree.org/meta-schemas/core.yaml#"

title: Cirrus Logic LN8411 Switched Cap Charger

maintainers:
 - Ricardo Rivera-Matos <rriveram@opensource.cirrus.com>

description: |
  The LN8411 is a 16-A, 4:1 switched capacitor fast charger for 1S
  battery applications. The architecture supports dual inputs by controlling
  2 external FETs which enable 20V PPS fast USB charging and 20V
  fast wireless charging with a single device.

properties:
  compatible:
    enum:
      - cirrus,ln8411-usb
      - cirrus,ln8411-dual
      - cirrus,ln8411-main
      - cirrus,ln8411-secondary

  reg:
    maxItems: 1

  cirrus,vbat-ovp-dis:
    type: boolean
    description: |
      Disable the VBAT_OVP.

  cirrus,vbat-ovp-dg-set:
    type: boolean
    description: |
      Set extra deglitch time for the VBAT_OVP.

  cirrus,vbat-ovp-mask:
    type: boolean
    description: |
      Mask interrupt outputs related to VBAT_OVP.

  cirrus,vbat-ovp-microvolt:
    description: |
      Battery over-voltage protection setting. When the battery voltage
      goes above this threshold, an interrupt is sent and the charging is
      disabled.
    default: 4450000
    minimum: 4450000
    maximum: 5225000

  cirrus,ibat-ocp-dis:
    type: boolean
    description: |
      Disable the IBAT_OCP.

  cirrus,ibat-ocp-mask:
    type: boolean
    description: |
      Mask interrupt outputs related to IBAT_OCP.

  cirrus,ibat-ocp-microamp:
    description: |
      Battery over-current protection setting. When the battery current
      goes above this threshold, an interrupt is sent and the charging is
      disabled.
    default: 12000000
    minimum: 10000000
    maximum: 17500000

  cirrus,ovpgate-on-dg-set:
    type: boolean
    description: |
      Set extra turn-on deglitch time for the OVPGATE.

  cirrus,vusb-ovp-mask:
    type: boolean
    description: |
      Mask interrupt outputs related to VUSB_OVP.

  cirrus,vusb-ovp-microvolt:
    description: |
      VUSB over-voltage protection setting. When the VUSB voltage
      goes above this threshold, the external back-to-back MOSFET will be
      turned off.
    default: 6500000
    minimum: 6500000
    maximum: 25000000

  cirrus,wpcgate-on-dg-set:
    type: boolean
    description: |
      Set extra turn-on deglitch time for the WPCGATE.

  cirrus,wpc-ovp-mask:
    type: boolean
    description: |
      Mask interrupt outputs related to VUSB_OVP.

  cirrus,vwpc-ovp-microvolt:
    description: |
      VUSB over-voltage protection setting. When the VUSB voltage
      goes above this threshold, the external back-to-back MOSFET will be
      turned off.
    default: 6500000
    minimum: 6500000
    maximum: 25000000

  cirrus,ibus-ucp-dis:
    type: boolean
    description: |
      Disable the IBUS_UCP.

  cirrus,ibus-ucp-rise-mask:
    type: boolean
    description: |
      Mask interrupt outputs related to IBUS_UCP rising.

  cirrus,ibus-ucp-fall-mask:
    type: boolean
    description: |
      Mask interrupt outputs related to IBUS_UCP falling.

  cirrus,ibus-ocp-dis:
    type: boolean
    description: |
      Disable the IBUS_OCP.

  cirrus,ibus-ocp-mask:
    type: boolean
    description: |
      Mask interrupt outputs related to IBUS_OCP.

  cirrus,ibus-ocp-microamp:
    description: |
      Bus over-current protection setting. When the bus current
      goes above this threshold, an interrupt is sent and the charging is
      disabled.
    default: 3500000
    minimum: 2500000
    maximum: 6250000

  cirrus,pmid2out-ovp-dis:
    type: boolean
    description: |
      Disable the PMID2OUT_OVP.

  cirrus,pmid2out-ovp-mask:
    type: boolean
    description: |
      Mask interrupt outputs related to PMID2OUT_OVP.

  cirrus,pmid2out-ovp:
    $ref: /schemas/types.yaml#/definitions/uint32
    description: |
      PMID/N-VOUT over-voltage-protection setting. When the PMID/N-VOUT
      voltage goes above the programmed threshold, an INT is sent and charging
      is disabled.

      0 = 5%
      1 = 7%
      2 = 9%
      ...
      7 = 19%
    default: 2
    minimum: 0
    maximum: 7

  cirrus,pmid2out-uvp-dis:
    type: boolean
    description: |
      Disable the PMID2OUT_UVP.

  cirrus,pmid2out-uvp-mask:
    type: boolean
    description: |
      Mask interrupt outputs related to PMID2OUT_UVP.

  cirrus,pmid2out-uvp:
    $ref: /schemas/types.yaml#/definitions/uint32
    description: |
      PMID/N-VOUT under-voltage-protection setting. When the PMID/N-VOUT
      voltage falls below the programmed threshold, an INT is sent and charging
      is disabled.

      0 = 2.5%
      1 = 4%
      2 = 6%
      ...
      7 = 16%
    default: 1
    minimum: 0
    maximum: 7

  cirrus,vbus-ovp-set:
    type: boolean
    description: |
      Set VBUS_OVP threshold across different modes.

      0: 5.6V in 1:1 mode, 12V in 2:1 mode, and 22V in 4:1 mode
      1: 16V in 1:1 mode, 13V in 2:1 mode, and 23V in 4:1 mode

  cirrus,set-ibat-sns-res:
    type: boolean
    description: |
      Selects the external BAT_SNS resistor value.

      0: 1mΩ
      1: 2mΩ

  cirrus,freq-shift:
    type: boolean
    description: |
      Adjust switching frequency for improved EMI performance.

      0: Nominal frequency
      1: Spread spectrum varies frequency +/-10%

  cirrus,wd-timeout-ms:
    description: |
      Watchdog timeout proteciton, 0 disables the watchdog.
    default: 0
    minimum: 0
    maximum: 255000
    enum: [ 0, 200, 500, 1000, 5000, 30000, 100000, 255000 ]

  cirrus,switching-frequency-hz:
    description: |
      Sets the converter switching frequency in Hz.
    default: 390
    minimum: 235
    maximum: 1070
    enum: [ 235000, 260000, 290000, 315000, 340000, 365000, 390000, 420000, 435000, 460000, 480000, 505000, 530000, 550000, 570000, 595000, 470000, 530000, 580000, 635000, 685000, 735000, 785000, 835000, 870000, 920000, 965000, 1015000, 1060000, 1105000, 1150000, 1070000 ]

  interrupts:
    maxItems: 1
    description: |
      Active low logic output for alerting status change to a corresponding
      event.

  monitored-battery:
    $ref: /schemas/types.yaml#/definitions/phandle
    description: phandle to the battery node being monitored

required:
  - compatible
  - reg
  - monitored-battery

unevaluatedProperties: false

examples:
 - |
  battery {
    compatible = "simple-battery";
  };

  i2c {
    charger@6e {
      compatible = "cirrus,ln8411-main";
      reg = <0x6e>;
      monitored-battery = <&bat>;

      interrupt-parent = <&bat>;
      interrupts = <16 IRQ_TYPE_EDGE_FALLING>;
    };

    charger@6f {
      compatible = "cirrus,ln8411-secondary"
      reg = <0x6e>;
      monitored-battery = <&bat>;

      interrupt-parent = <&bat>;
      interrupts = <16 IRQ_TYPE_EDGE_FALLING>;
    };
  };
...
```

## Documentation/devicetree/bindings/sound/cirrus,alg.txt
```
Cirrus Logic CLSIC Algorithm Service Codec

The CLSIC MFD device driver starts a clsic-alg codec driver to manage the Algorithm Service
present within CS48LV40 devices.

Required properties:
- compatible : "cirrus,clsic-alg"
- #sound-dai-cells : "<1>"

Example:

cs48lv40: cs48lv40@0 {
	compatible = "cirrus,clsic";
	cs48lv40_alg: cs48lv40_alg@0 {
		compatible = "cirrus,clsic-alg";
		#sound-dai-cells = <1>;
	};
};
```

## Documentation/devicetree/bindings/sound/cirrus,madera.yaml
```yaml
# SPDX-License-Identifier: GPL-2.0-only OR BSD-2-Clause
%YAML 1.2
---
$id: http://devicetree.org/schemas/sound/cirrus,madera.yaml#
$schema: http://devicetree.org/meta-schemas/core.yaml#

title: Cirrus Logic Madera class audio CODECs

maintainers:
  - patches@opensource.cirrus.com

description: |
  This describes audio configuration bindings for these codecs.

  See also the core bindings for the parent MFD driver:

    Documentation/devicetree/bindings/mfd/cirrus,madera.yaml

  and defines for values used in these bindings:

    include/dt-bindings/sound/madera.h

  The properties are all contained in the parent MFD node.

allOf:
  - $ref: dai-common.yaml#

properties:
  '#sound-dai-cells':
    description:
      The first cell indicating the audio interface.
    const: 1

  cirrus,inmode:
    description:
      A list of input mode settings for each input. A maximum
      of 24 cells, with four cells per input in the order INnAL,
      INnAR INnBL INnBR.  For non-muxed inputs the first two cells
      for that input set the mode for the left and right channel
      and the second two cells must be 0.  For muxed inputs the
      first two cells for that input set the mode of the left and
      right A inputs and the second two cells set the mode of the
      left and right B inputs.  Valid mode values are one of the
      MADERA_INMODE_xxx. If the array is shorter than the number
      of inputs the unspecified inputs default to MADERA_INMODE_DIFF.
    $ref: /schemas/types.yaml#/definitions/uint32-array
    minItems: 1
    maxItems: 24
    items:
      minimum: 0
      maximum: 1
      default: 0

  cirrus,out-mono:
    description:
      Mono bit for each output, maximum of six cells if the array
      is shorter outputs will be set to stereo.
    $ref: /schemas/types.yaml#/definitions/uint32-array
    minItems: 1
    maxItems: 6
    items:
      minimum: 0
      maximum: 1
      default: 0

  cirrus,dmic-ref:
    description: |
      Indicates how the MICBIAS pins have been externally connected
      to DMICs on each input, one cell per input.

        <IN1 IN2 IN3 ...>

      A value of 0 indicates MICVDD and is the default,
      other values depend on the codec: For CS47L35 one of the
      CS47L35_DMIC_REF_xxx values For all other codecs one of
      the MADERA_DMIC_REF_xxx values Also see the datasheet for a
      description of the INn_DMIC_SUP field.
    $ref: /schemas/types.yaml#/definitions/uint32-array
    minItems: 1
    maxItems: 6
    items:
      minimum: 0
      maximum: 3
      default: 0

  cirrus,max-channels-clocked:
    description:
      Maximum number of channels that I2S clocks will be generated
      for. Useful when clock master for systems where the I2S bus
      has multiple data lines.  One cell for each AIF, use a value
      of zero for AIFs that should be handled normally.
    $ref: /schemas/types.yaml#/definitions/uint32-array
    minItems: 1
    maxItems: 4
    items:
      default: 0

  cirrus,pdm-fmt:
    description:
      PDM speaker data format, must contain 2 cells (OUT5 and
      OUT6). See the PDM_SPKn_FMT field in the datasheet for a
      description of this value. The second cell is ignored for
      codecs that do not have OUT6.
    $ref: /schemas/types.yaml#/definitions/uint32-array
    minItems: 2
    maxItems: 2

  cirrus,pdm-mute:
    description: |
      PDM mute format, must contain 2 cells (OUT5 and OUT6). See the
      PDM_SPKn_CTRL_1 register in the datasheet for a description
      of this value.  The second cell is ignored for codecs that
      do not have OUT6.
    $ref: /schemas/types.yaml#/definitions/uint32-array
    minItems: 2
    maxItems: 2

  cirrus,micd-detect-debounce-ms:
    description: |
     Extra debounce timeout during initial mic detect (milliseconds)
    $ref: /schemas/types.yaml#/definitions/uint32
    maxItems: 1

  cirrus,micd-manual-debounce:
    description: |
      Extra software debounces during button detection
    $ref: /schemas/types.yaml#/definitions/uint32
    maxItems: 1

  cirrus,micd-bias-start-time:
    description: |
      Time allowed for MICBIAS to startup prior to
      performing microphone detection, specified as per the MICD_BIAS_STARTTIME
    $ref: /schemas/types.yaml#/definitions/uint32
    maxItems: 1

  cirrus,micd-rate:
    description: |
      Delay between successive microphone detection
      measurements, specified as per the MICD_RATE bits in the register
      MIC_DETECT_1.
    $ref: /schemas/types.yaml#/definitions/uint32
    maxItems: 1

  cirrus,micd-dbtime:
    description: |
      Mic detect debounce level
    $ref: /schemas/types.yaml#/definitions/uint32
    maxItems: 1

  cirrus,micd-timeout-ms:
    description: |
      Mic detect timeout (milliseconds)
    $ref: /schemas/types.yaml#/definitions/uint32
    maxItems: 1

  cirrus,micd-force-micbias:
    description: |
    $ref: /schemas/types.yaml#/definitions/bool
    maxItems: 1

  cirrus,jd-use-jd2:
    description: |
      Set whether JD2 is used for jack detection
    $ref: /schemas/types.yaml#/definitions/bool
    maxItems: 1

  cirrus,jd-invert:
    description: |
      Set to true if jackdet contact opens on insert
    $ref: /schemas/types.yaml#/definitions/bool
    maxItems: 1

  cirrus,fixed-hpdet-imp:
    description: |
      If non-zero don't run headphone detection, just report this value
      Specified as hundredths-of-an-ohm, that is (ohms * 100)
    $ref: /schemas/types.yaml#/definitions/uint32
    maxItems: 1

  cirrus,hpdet-short-circuit-imp:
    description: |
      If non-zero, specifies the maximum impedance in ohms
      that will be considered as a short circuit.
    $ref: /schemas/types.yaml#/definitions/uint32
    maxItems: 1

  cirrus,hpdet-channel:
    description: |
      Channel to use for headphone detection, valid values are 0 for
      left and 1 for right.
    $ref: /schemas/types.yaml#/definitions/uint32
    maxItems: 1

  cirrus,micd-clamp-mode:
    description: |
      Mic detect clamp function
    $ref: /schemas/types.yaml#/definitions/uint32
    maxItems: 1

  cirrus,hpdet-ext-res:
    description: |
      Impedance of external series resistor on hpdet.
      Specified as hundredths-of-an-ohm, that is (ohms * 100)
    $ref: /schemas/types.yaml#/definitions/uint32
    maxItems: 1

  cirrus,hpd-pins:
    description: |
    $ref: /schemas/types.yaml#/definitions/uint32-array
    minItems: 1
    maxItems: 1

  cirrus,micd-configs:
    description: |
      Headset polarity configurations, variable length but
      must be a multiple of 5 cells, each 5-cell group represents one
      polarity configuration. First cell is the value of ACCDET_SRC
      register field (CS47L15, CS47L90 etc.), MICD_SENSE_SEL register
      field (all other codecs). Second cell is the accessory detection
      ground as per the MICD_GND_SEL register field. The third cell is
      the MICBIAS to be used as per the MICD_BIAS_SRC register field.
      Fourth cell is the value of the micd-pol-gpio pin, a non-zero value
      indicates this should be on. Fifth cell is set to zero (cs47l15)
      value of HPn_GND_SEL register field (all other codecs)
    $ref: /schemas/types.yaml#/definitions/uint32-array
    minItems: 1
    maxItems: 1

  cirrus,micd-ranges:
    description: |
      Microphone detection level and key configuration, this
      field can be of variable length but should always be a multiple of 2 cells
      long, each two cell group represents one button configuration
      The first cell is the maximum impedance for this button in ohms
      The second cell the key that should be reported to the input layer
    $ref: /schemas/types.yaml#/definitions/uint32-array
    minItems: 1
    maxItems: 1

additionalProperties: true
```

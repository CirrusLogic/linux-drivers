## Documentation/devicetree/bindings/mfd/clsic.txt
```
Cirrus Logic CLSIC multi-function device

These devices are audio SoCs with extensive digital capabilities and a range
of analogue I/O.

See also the child driver bindings in:
bindings/pinctrl/cirrus,tacna-pinctrl.txt
bindings/regulator/arizona-regulator.txt
bindings/sound/clsic.txt

Required properties:

  - compatible : should be "cirrus,clsic"

  - reg : chip select number for SPI.

  - VDD_D-supply : Power supply for the device as defined in
    bindings/regulator/regulator.txt

  - VDD_A-supply, VDD_IO1-supply: Power supplies for the device

  - interrupt-controller : Indicates that this device is an interrupt controller

  - #interrupt-cells: the number of cells to describe an IRQ, must be 2.
    The first cell is the IRQ number.
    The second cell is the flags, encoded as the trigger masks from
    bindings/interrupt-controller/interrupts.txt

  - interrupt-parent : The parent interrupt controller.

  - interrupts : The interrupt line the /IRQ signal for the device is
    connected to.

  - gpio-controller : Indicates this device is a GPIO controller.

  - #gpio-cells : Must be 2. The first cell is the pin number. The second cell
    is reserved for future use and must be zero

Optional properties:

  - reset-gpios : One entry specifying the GPIO controlling RESET_B.
    As defined in bindings/gpio.txt.

  - pinctrl-names : Name of pinctrl configurations. Each of these is optional.
    Legal names are:
	"probe" - external pinctrl dependencies required to probe this codec,
		typically these are for the reset GPIO and IRQ pin, though
		could include clocks. Do NOT include configuration of this
		codec's own GPIO pins because these can't be applied until
		after the mfd probe has completed.

	"active" - full set of external and local pinctrl configurations to
		apply after probe including all the configuration of the GPIO
		pins on this codec (bindings/pinctrl/cirrus,tacna-pinctrl.txt).
		This must include the external dependencies in the "probe"
		configuration, since they will still be required after probe.

    Do not use "default" since it is applied too early before the mfd has
    fully probed the codec.

  - pinctrl-0 : handle to pinctrl configurations matching the entries in
    pinctrl-names

  - volatile_memory : Bool defining system without flash memory

Example:

codec: cs48lx50@0 {
	compatible = "cirrus,clsic";
	reg = <0>;

	interrupt-controller;
	#interrupt-cells = <2>;
	interrupts = <13 8>;
	interrupt-parent = <&gpio>;

	reset-gpio = <&gpio 0>;

	gpio-controller;
	#gpio-cells = <2>;

	VDD_A-supply = <&regulator_dummy>;
	VDD_IO1-supply = <&regulator_dummy>;
	VDD_D-supply = <&regulator_dummy>;

	pinctrl-names = "active";
	pinctrl-0 = <&cs48lx50_defaults>;

	cs48lx50_pinctrl: tacna-pinctrl {
		compatible = "cirrus,tacna-pinctrl";

		cs48lx50_defaults: defaults {
			asp1 {
				groups = "asp1";
				function = "asp1";
				bias-bus-hold;
			};
			asp2 {
				groups = "asp2";
				function = "asp2";
				bias-bus-hold;
			};
			in3-pdm {
				groups = "in3-pdm";
				function ="in3-pdm";
				bias-bus-hold;
			};
			in4-pdm {
				groups = "in4-pdm";
				function ="in4-pdm";
				bias-bus-hold;
			};
		};
	};
};
```

## Documentation/devicetree/bindings/mfd/tacna.txt
```
Cirrus Logic Tacna class audio codecs multi-function device

These devices are audio SoCs with extensive digital capabilities and a range
of analogue I/O.

See also the child driver bindings in:
bindings/extcon/extcon-tacna.txt
bindings/gpio/gpio-tacna.txt
bindings/pinctrl/cirrus,tacna-pinctrl.txt
bindings/regulator/arizona-regulator.txt
bindings/sound/tacna.txt

Required properties:

  - compatible : One of the following chip-specific strings:
        "cirrus,cs47l96"
        "cirrus,cs47l97"

  - reg : I2C slave address when connected using I2C, chip select number when
    using SPI.

  - VDD_D-supply : Power supply for the device as defined in
    bindings/regulator/regulator.txt

  - VDD_A-supply, VDD_IO1-supply, VDD_IO2-supply,
    VDD1_CP-supply, VDD2_CP-supply, VDD3_CP-supply:
    Power supplies for the device

  - interrupt-controller : Indicates that this device is an interrupt controller

  - #interrupt-cells: the number of cells to describe an IRQ, must be 2.
    The first cell is the IRQ number.
    The second cell is the flags, encoded as the trigger masks from
    bindings/interrupt-controller/interrupts.txt

  - interrupt-parent : The parent interrupt controller.

  - interrupts : The interrupt line the /IRQ signal for the device is
    connected to.

  - gpio-controller : Indicates this device is a GPIO controller.

  - #gpio-cells : Must be 2. The first cell is the pin number. The second cell
    is reserved for future use and must be zero

Optional properties:

  - reset-gpios : One entry specifying the GPIO controlling RESET_B.
    As defined in bindings/gpio.txt.

  - pinctrl-names : Name of pinctrl configurations. Each of these is optional.
    Legal names are:
	"probe" - external pinctrl dependencies required to probe this codec,
		typically these are for the reset GPIO and IRQ pin, though
		could include clocks. Do NOT include configuration of this
		codec's own GPIO pins because these can't be applied until
		after the mfd probe has completed.

	"active" - full set of external and local pinctrl configurations to
		apply after probe including all the configuration of the GPIO
		pins on this codec (bindings/pinctrl/cirrus,tacna-pinctrl.txt).
		This must include the external dependencies in the "probe"
		configuration, since they will still be required after probe.

    Do not use "default" since it is applied too early before the mfd has
    fully probed the codec.

  - pinctrl-0, pinctrl-1 : handle to pinctrl configurations matching the
    entries in pinctrl-names

  - cirrus,clk32k-src : set the input source for the codec 32kHz clock.
	See the TACNA_32KZ_* macros in include/dt-bindings/mfd/tacna.h for
	valid options.
	cs48l32 will default to MCLK1, all other codecs will default to MCLK2.

Optional child nodes:
  - MICBIASx : Initial data for the MICBIAS regulators, as covered in
    Documentation/devicetree/bindings/regulator/regulator.txt.

    One for each MICBIAS generator (MICBIAS1, MICBIAS2, ...)

    One for each output pin (MICBIAS1A, MIBCIAS1B, MICBIAS2A, ...)

    The following property is supported for all nodes:
      - regulator-active-discharge:
	0: Disable active discharge.
	1: Enable active discharge.

    The following following additional property is supported for the generator
    nodes:
      - cirrus,ext-cap : Set to 1 if the MICBIAS has external decoupling
        capacitors attached.

Example:

codec: cs47l96@0 {
	compatible = "cirrus,cs47l96";
	reg = <0>;

	interrupt-controller;
	#interrupt-cells = <2>;
	interrupt-parent = <&main_pic>;
	interrupts = <1 0>;

	gpio-controller;
	#gpio-cells = <2>;

	VDD_A-supply = <&regulator_dummy>;
	VDD_IO1-supply = <&regulator_dummy>;
	VDD1_CP-supply = <&regulator_dummy>;
	VDD2_CP-supply = <&regulator_dummy>;
	VDD3_CP-supply = <&regulator_dummy>;
	VDD_D-supply = <&regulator_dummy_dcvdd>;

	reset-gpios = <&gpio 0>;

	pinctrl-names = "probe", "active";
	pinctrl-0 = <&gpio_0_enable_state>;
	pinctrl-1 = <&gpio_0_enable_state &cs47l96_gpio_config>;

	cs47l96_gpio_config: cs47l96-gpio-config {
		asp2 {
			groups = "asp2";
			function = "asp2";
			bias-bus-hold;
		};

		opclk {
			groups = "gpio1";
			function = "opclk";
			bias-pull-up;
			drive-strength = <8>;
		};
	};

	MICBIAS1 {
		regulator-min-microvolt = <900000>;
		regulator-max-microvolt = <3300000>;
		cirrus,ext-cap = <1>;
	};
};
```

## Documentation/devicetree/bindings/pinctrl/cirrus,tacna-pinctrl.txt
```
Cirrus Logic Tacna class audio codecs pinctrl driver

The Cirrus Logic Tacna codecs provide a number of GPIO functions for
interfacing to external hardware and to provide logic outputs to other devices.
Certain groups of GPIO pins also have an alternate function, normally as an
audio interface.

The set of available GPIOs, functions and alternate function groups differs
between codecs so refer to the datasheet for the codec for further information
on what is supported on that device.

The properties for this driver must exist within the parent MFD driver node.
See bindings/mfd/tacna.txt.

See also
  the core bindings for the parent MFD driver:
    Documentation/devicetree/bindings/mfd/tacna.txt

  the generic pinmix bindings:
    Documentation/devicetree/bindings/pinctrl/pinctrl-bindings.txt

Required properties of configuration subnodes:
  - groups : name of one pin group to configure. One of:
        asp2, asp3, asp4, dsd1, in1-pdm, in2-pdm, in3-pdm, in4-pdm, out5-pdm,
        gpio1, gpio2, ..., gpio23
    The gpioN groups select the single pin of this name for configuration

Optional properties of configuration subnodes:
  Any configuration option not explicitly listed in the dts will be left at
  chip default setting.

  - function : name of function to assign to this group. One of (actual
    available will differ from codec to codec, refer to the datasheet for
    more information):
        asp1, asp2, asp3, asp4, asp1ao, dsd1, in1-pdm, in2-pdm, in3-pdm,
        in4-pdm, out5-pdm, io, dsp-gpio, irq1,
        fll1-clk, fll1-lock, fll2-clk, fll2-lock, fll3-clk, fll3-lock,
        opclk, opclk-async, opclk-dsp,
        pwm1-out, pwm2-out,
        input-path-signal-detect,
        ultrasonic-in1-activity-detect, ultrasonic-in2-activity-detect,
        asrc1-in1-lock, asrc1-in2-lock,
        dfc1-saturate,
        dma-ch0-programmable-transfer-complete,
        dma-ch1-programmable-transfer-complete,
        dma-ch2-programmable-transfer-complete,
        dma-ch3-programmable-transfer-complete,
        dma-ch4-programmable-transfer-complete,
        dma-ch5-programmable-transfer-complete,
        dma-ch6-programmable-transfer-complete,
        dma-ch7-programmable-transfer-complete,
        out1r-hp1-enable-disable-sequence, out1l-hp1-enable-disable-sequence,
        out1r-hp2-enable-disable-sequence, out1l-hp2-enable-disable-sequence,
        out2r-enable-disable-sequence, out2l-enable-disable-sequence,
        outh-enable-disable-sequence,
        sample-rate-change-trigger-a, sample-rate-change-trigger-b,
        sample-rate-change-trigger-c, sample-rate-change-trigger-d,
        timer1-irq-ch1, timer1-irq-ch2, timer1-irq-ch3, timer1-irq-ch4,
        timer2-irq-ch1, timer2-irq-ch2, timer2-irq-ch3, timer2-irq-ch4,
        timer3-irq-ch1, timer3-irq-ch2, timer3-irq-ch3, timer3-irq-ch4,
        timer4-irq-ch1, timer4-irq-ch2, timer4-irq-ch3, timer4-irq-ch4,
        timer5-irq-ch1, timer5-irq-ch2, timer5-irq-ch3, timer5-irq-ch4,
        timer-1, timer-2, timer-3, timer-4, timer-5

  - bias-disable : disable pull-up and pull-down
  - bias-bus-hold : enable buskeeper
  - bias-pull-up : output is pulled-up
  - bias-pull-down : output is pulled-down
  - drive-push-pull : CMOS output
  - drive-open-drain : open-drain output
  - drive-strength : drive strength in mA. See the datasheet for a list of valid
  values for your codec.
  - output-low : set the pin to output mode with low level
  - output-high : set the pin to output mode with high level

Example:

codec: cs47l96@0 {
	compatible = "cirrus,cs47l96";

	pinctrl-names = "active";
	pinctrl-0 = <&cs47l96_gpio_config>;

	cs47l96_gpio_config: cs47l96-gpio-config {
		asp2 {
			groups = "asp2";
			function = "asp2";
			bias-bus-hold;
		};

		opclk {
			groups = "gpio1";
			function = "opclk";
			bias-pull-up;
			drive-strength = <8>;
		};
	};
};
```

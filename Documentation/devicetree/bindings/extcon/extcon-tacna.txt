## Documentation/devicetree/bindings/sound/clsic.txt
```
Cirrus Logic CLSIC multi-function device

This describes audio configuration bindings for these codecs.

See also the core bindings for the parent MFD driver:
See Documentation/devicetree/bindings/mfd/clsic.txt

These properties are all contained in the parent MFD node.

Optional properties:
  - host_controls_dsp2 : CLSIC devices may permit the second Halo Core to
  be used as a general purpose audio DSP and delegate all control to the host.
  In this case the Halo Core is managed as a DSP using the Cirrus Logic Tacna
  audio infrastructure.

Example:

cs48lx50@0 {
	compatible = "cirrus,clsic";

	host_controls_dsp2;
};
```

## Documentation/devicetree/bindings/sound/cs35l35.txt
```
CS35L35 Speaker Amplifier

Required properties:

  - compatible : "cirrus,cs35l35"

  - reg : the I2C address of the device for I2C

  - VA-supply, VP-supply : power supplies for the device,
    as covered in
    Documentation/devicetree/bindings/regulator/regulator.txt.

Optional properties:
  - cirrus,reset-gpios : gpio used to reset the amplifier

  - cirrus,stereo-config : Boolean to determine if there are 2 AMPs for a
  Stereo configuration

  - cirrus,shared-boost : Boolean to enable ClassH tracking of Advisory Signal
  if 2 Devices share Boost BST_CTL

  - cirrus,sp-drv-strength : Value for setting the Serial Port drive strength
  Table 3-10 of the datasheet lists drive-strength specifications
  0 = 1x (Default)
  1 = .5x

  - cirrus,bst-pdn-fet-on : Boolean to determine if the Boost PDN control
  powers down with a rectification FET On or Off. If VSPK is supplied
  externally then FET is off.

  - cirrus,boost-ctl : Boost Converter control word. Step Size of 0.1V
  0x00 = (Default) VP
  0x41 = 9.0V

  - cirrus,amp-gain-zc : Boolean to determine if to use Amplifier gain-change
  zero-cross

  - cirrus,audio-channel : Set Location of Audio Signal on Serial Port
  0 = Data Packet received on Left I2S Channel
  1 = Data Packet received on Right I2S Channel

  - cirrus,advisory-channel : Set Location of Advisory Signal on Serial Port
  0 = Data Packet received on Left I2S Channel
  1 = Data Packet received on Right I2S Channel

  - cirrus,classh-internal-algo : Settings for the Internal Class H Algorithm
  See Section 4.3 Internal Class H Algorithm in the Datasheet.
  If not used, the device manages the ClassH Algorithm internally.

  -cirrus,monitor-signal-format : Settings for adjusting the Depth, Location
  and Frame of the Monitoring Signals for Algorithms
  See Sections 4.8.2 through 4.8.4 Serial-Port Control in the Datasheet
  Each of the 3 8 bit values in the array contain the settings for 
  depth, location, and frame.
  If not used, the defaults for the 6 monitor signals is used.

Example:

cs35l35: cs35l35@20 {
	compatible = "cirrus,cs35l35";
	reg = <0x20>;
	VA-supply = <&dummy_vreg>;
	VP-supply = <&dummy_vreg>;
	reset-gpios = <&axi_gpio 54 0>;
	cirrus,boost-ctl = <0x41>;

	cirrus,classh-internal-algo {
		cirrus,classh-bst-overide;
		cirrus,classh-bst-max-limit = <0x01>;
		cirrus,classh-mem-depth = <0x01>;
		cirrus,classh-release-rate = <0x08>;
		cirrus,classh-headroom = <0x0B>;
		cirrus,classh-wk-fet-disable = <0x01>;
		cirrus,classh-wk-fet-delay = <0x04>;
		cirrus,classh-wk-fet-thld = <0x01>;
		cirrus,classh-vpch-auto = <0x01>;
		cirrus,classh-vpch-rate = <0x02>;
		cirrus,classh-vpch-man = <0x05>;
	};

	/* Depth, Location, Frame */
	cirrus,monitor-signal-format {
		cirrus,imon = /bits/ 8 <0x03 0x00 0x01>;
		cirrus,vmon = /bits/ 8 <0x03 0x00 0x00>;
		cirrus,vpmon = /bits/ 8 <0x03 0x04 0x00>;
		cirrus,vbstmon = /bits/ 8 <0x03 0x04 0x01>;
		cirrus,vpbrstat = /bits/ 8 <0x00 0x04 0x00>;
		cirrus,zerofill = /bits/ 8 <0x00 0x00 0x00>;
	};

};
```

## Documentation/devicetree/bindings/sound/cs35l43.txt
```
CS35L43 Speaker Amplifier

Required properties:

  - compatible : "cirrus,cs35l43"

  - reg : the I2C address of the device for I2C

  - VA-supply, VP-supply : power supplies for the device,
    as covered in
    Documentation/devicetree/bindings/regulator/regulator.txt.

Optional properties:

  - reset-gpios : gpio used to reset the amplifier

  - interrupts : IRQ line info CS35L43.
  (See Documentation/devicetree/bindings/interrupt-controller/interrupts.txt
  for further information relating to interrupt properties)

  - cirrus,asp-sdout-hiz : Audio serial port SDOUT Hi-Z control. Sets the Hi-Z
  configuration for SDOUT pin of amplifier.

  0 = Logic 0 during unused slots, and while all transmit channels disabled
  1 = Hi-Z during unused slots but logic 0 while all transmit channels disabled
  2 = (Default) Logic 0 during unused slots, but Hi-Z while all transmit channels disabled
  3 = Hi-Z during unused slots and while all transmit channels disabled

  - cirrus,boost-ctl-millivolt : Boost Voltage Value. Configures the
  boost converter's output voltage in mV. The range is from 2550 mV to
  11000 mV with increments of 50 mV. This value will only be used if
  'cirrus,classh-disable' is also set to true.
  (Default) VP

  - cirrus,bst-ipk-ma : Boost-converter peak current limit in mA.
  Configures the peak current by monitoring the current through the boost FET.
  Range starts at 1600 mA and goes to a maximum of 4500 mA with increments
  of 50 mA.
  (Default) 4.50 Amps

  - cirrus,classh-disable : Boolean which will disable Class H tracking and
  set Boost voltage to the value in the 'boost-ctl-millivolt' property

  - cirrus,hw-noise-gate-select : Hardware Noise Gate feature. Each bit selects
  a different block for detection.

  000000 - All noise gating functionality disabled
  xxxxx1 - Amplifier noise gating detection enabled
  xxxx1x - Boost converter DCM detection enabled
  xxx1xx - VMON and IMON low power mode detection enabled
  x1xxxx - VP brownout prevention detection enabled
  1xxxxx - VBST brownout prevention detection enabled

  - cirrus,hw-noise-gate-delay : Time that the incoming audio signal must be
  below the noise gate threshold prior to entering a noise gated state

  0 = 5 ms
  1 = 10 ms
  2 = 25 ms
  3 = 50 ms (default)
  4 = 100 ms
  5 = 250 ms
  6 = 500 ms
  7 = 1 s

  - cirrus,hw-noise-gate-threshold : Threshold of audio signal input which the
  noise gate considers the input audio to be at a low enough level to be
  valid to enter a noise gating state of operation.

  0 = 0.654 mVpk
  1 = 0.328 mVpk
  2 = 0.164 mVpk
  3 = 0.082 mVpk (default)
  4 = 0.041 mVpk
  5 = 0.021 mVpk
  6 = 0.010 mVpk
  7 = True zero data (no LSB dither)

  - cirrus,dsp-noise-gate-enable : DSP Noise Gate feature. If present, noise
  gate feature will be enabled.

  - cirrus,dsp-noise-gate-threshold : Threshold of audio signal input which the
  noise gate considers the input audio to be at a low enough level to be
  valid to enter a noise gating state of operation.

  0 = -66 dBFS
  1 = -72 dBFS
  2 = -78 dBFS
  3 = -84 dBFS (default)
  4 = -90 dBFS
  5 = -96 dBFS
  6 = -102 dBFS
  7 = -108 dBFS

  - cirrus,dsp-noise-gate-delay : Time that the incoming audio signal must be
  below the noise gate threshold prior to entering a noise gated state

  0 = 5 ms
  1 = 10 ms
  2 = 25 ms
  3 = 50 ms (default)
  4 = 100 ms
  5 = 250 ms
  6 = 500 ms
  7 = 1 s
  8 = 5 s
  9 = 10 s
  10 = 20 s
  11 = 30 s
  12 = 40 s
  13 = 50 s
  14 = 60 s
  15 = 120 s

  - cirrus,gpio1-output-enable : Boolean which specifies whether the GPIO1 pin
  is configured as an output. If this property is not present the
  pin will be configured as an input.

  - cirrus,gpio1-src-select : Configures the function of the GPIO1 pin.
  Note that the options are different from the GPIO2 pin.

  0 = High Impedance (Default)
  1 = GPIO
  2 = Sync
  3 = MCLK input

  - cirrus,gpio2-output-enable : Boolean which specifies whether the GPIO2 pin
  is configured as an output. If this property is not present the
  pin will be configured as an input.

  - cirrus,gpio2-src-select : Configures the function of the GPIO2 pin.
  Note that the options are different from the GPIO1 pin.

  0 = High Impedance (Default)
  1 = GPIO
  2 = Open Drain INTB
  3 = MCLK input
  4 = Push-pull INTB (active low)
  5 = Push-pull INT (active high)

  - cirrus,vpbr-enable : Enable VP brownout prevention (Boolean)

  - cirrus,vpbr-rel-rate : VP brownout prevention attenuation release step rate.
  Configures the delay between consecutive volume attenuation release steps when
  a brownout condition is no longer present and the VP brownout is in an attenuation
  release state.

  0 = 5 ms
  1 = 10 ms
  2 = 25 ms
  3 = 50 ms
  4 = 100 ms
  5 = 250 ms (default)
  6 = 500 ms
  7 = 1 s

  - cirrus,vpbr-wait : Configures the delay between a brownout condition no longer being
  present and the VP brownout prevention entering an attenuation release state.

  0 = 10 ms
  1 = 100 ms (default)
  2 = 250 ms
  3 = 500 ms

  - cirrus,vpbr-atk-rate : Attenuation attack step rate. Configures the amount of delay
  in microseconds between consecutive volume attenuation steps when a brownout condition is
  present and the VP brownout condition is in an attacking state.

  0 = 2.5 us
  1 = 5 us
  2 = 10 us (default)
  3 = 25 us
  4 = 50 us
  5 = 100 us
  6 = 250 ms
  7 = 500 us

  - cirrus,vpbr-atk-vol : VP brownout prevention attack step size. COnfigures the VP brownout
  prevention attacking attenuation step size.

  - cirrus,vpbr-max-att: Maximum attenuation that the VP brownout prevention can apply to the
  audio signal. Step size is 1 dB.

  0 = 0 dB
  1 = 1 dB
  ...
  9 = 9 dB (default)
  ...
  15 = 15 dB

  - cirrus,vpbr-thld : Configures the VP brownout threshold voltage


Example:

cs35l43: cs35l43@40 {
  compatible = "cirrus,cs35l43";
  reg = <0x40>;
  VA-supply = <&dummy_vreg>;
  VP-supply = <&dummy_vreg>;
  interrupt-parent = <&gpio8>;
  interrupts = <3 IRQ_TYPE_LEVEL_LOW>;
  reset-gpios = <&gpio 110 0>;

  cirrus,bst-ipk-ma = <4000>;
  cirrus,asp-sdout-hiz = <3>;
  cirrus,gpio2-src-sel = <4>;
};
```

## Documentation/devicetree/bindings/sound/cs35l45.txt
```
CS35L45 Speaker Amplifier

Required properties:

  - compatible : "cirrus,cs35l45"

  - reg : the SPI chip select line or I2C device address for the device

  - VA-supply, VP-supply : power supplies for the device,
    as covered in
    Documentation/devicetree/bindings/regulator/regulator.txt.

Optional properties:
  - reset-gpios : gpio used to reset the amplifier

Optional GPIOX Sub-nodes:

  Details found in section 4.23

  The cs35l45 node can have up to three "cirrus,gpio-ctrlX" ('X' = [1,2,3])
  sub-nodes for configuring the GPIO pins.

  - gpio-dir : GPIO pin direction. Valid only when 'gpio-ctrl'
    is 1.

    0 = Output
    1 = Input (Default)

  - gpio-lvl : GPIO level. Valid only when 'gpio-ctrl' is 1 and 'gpio-dir' is 0.

    0 = Low (Default)
    1 = High

  - gpio-op-cfg : GPIO output configuration. Valid only when 'gpio-ctrl' is 1
    and 'gpio-dir' is 0.

    0 = CMOS (Default)
    1 = Open Drain

  - gpio-pol : GPIO output polarity select. Valid only when 'gpio-ctrl' is 1
    and 'gpio-dir' is 0.

    0 = Non-inverted, Active High (Default)
    1 = Inverted, Active Low

  - gpio-invert : Defines the polarity of the GPIO pin if configured
    as input.

    0 = Not inverted (Default)
    1 = Inverted

  - gpio-ctrl : Defines the function of the GPIO pin.

  GPIO1:
    0 = High impedance input (Default)
    1 = Pin acts as a GPIO, direction controlled by 'gpio-dir'
    2 = Pin acts as MDSYNC, direction controlled by MDSYNC
    3-7 = Reserved

  GPIO2:
    0 = High impedance input (Default)
    1 = Pin acts as a GPIO, direction controlled by 'gpio-dir'
    2 = Pin acts as open drain INT
    3 = Reserved
    4 = Pin acts as push-pull output INT. Active low.
    5 = Pin acts as push-pull output INT. Active high.
    6,7 = Reserved

  GPIO3:
    0 = High impedance input (Default)
    1 = Pin acts as a GPIO, direction controlled by 'gpio-dir'
    2-7 = Reserved

Example:

cs35l45: cs35l45@2 {
	compatible = "cirrus,cs35l45";
	reg = <2>;
	VA-supply = <&dummy_vreg>;
	VP-supply = <&dummy_vreg>;
	reset-gpios = <&gpio0 54 0>;

	cirrus,gpio-ctrl2 {
		gpio-ctrl = <0x02>;
	};
};
```

## Documentation/devicetree/bindings/sound/madera.txt
```
Cirrus Logic Madera class audio codecs

See also the core bindings for the parent MFD driver:
See Documentation/devicetree/bindinge/mfd/madera.txt

Optional properties:
  - cirrus,dmic-ref : DMIC reference for each input, one cell per input
    <IN1 IN2 IN3 ...>
    A value of 0 indicates MICVDD and is the default, other
    values depend on the codec - see the datasheet for the INn_DMIC_SUP field

  - cirrus,dmic-clksrc : DMIC clock source for each input (CS47L90, CS47L91,
    CS47L92, CS47L93).
    One cell per input. A value of 0 will source DMIC from the internally
    generated clock within the ADC subsystem and a value of 1 will source DMIC
    and External digital speakers with same clock

  - cirrus,inmode : A list of input mode settings for each input. A maximum
    of 16 cells, with four cells per input in the order INnAL, INnAR INnBL INnBR.
    For non-muxed inputs the first two cells for that input set the mode for
    the left and right channel and the second two cells must be 0.
    For muxed inputs (cs47l15, cs47l35, cs47l85 IN1, cs47l85 IN2) the first two
    cells for that input set the mode of the left and right A inputs and the
    second two cells set the mode of the left and right B inputs.
    Valid mode values are one of the MADERA_INMODE_xxx (see
    include/dt-bindings/sound/madera.h). If the array is shorter than the number
    of inputs the unspecified inputs default to MADERA_INMODE_DIFF.

  - cirrus,out-mono : Mono bit for each output, must contain six cells if
    specified. A non-zero value indicates the corresponding output is mono.

  - cirrus,max-channels-clocked : The maximum number of channels to be clocked
    on each AIF, useful for I2S systems with multiple data lines being mastered.
    One cell for each AIF, use a value of zero for AIFs that should be handled
    normally.

  - cirrus,auxpdm-slave-mode : If defined, Auxiliary PDM will be put into clock
    slave mode.  The default is clock master.

  - cirrus,auxpdm-falling-edge: If defined, data will be driven on the falling
    edge of the Auxiliary PDM clock.  The default is for the data to be driven
    on the rising edge.

  - cirrus,pdm-fmt : PDM speaker data format, must contain 2 cells (OUT5 and OUT6).
    See the datasheet for values.
    The second cell is ignored for codecs that do not have OUT6.

  - cirrus,pdm-mute : PDM speaker mute setting, must contain 2 cells (OUT5 and OUT6).
    See the datasheet for values.
    The second cell is ignored for codecs that do not have OUT6.

Example:

codec: cs47l35@0 {
	compatible = "cirrus,cs47l35";

	cirrus,dmic-ref = <0 0 1 0>;
	cirrus,dmic-clksrc = <0 0 0 0>;
	cirrus,inmode = <
		2 2 1 1 /* IN1A digital, IN1B single-ended */
		0 0 0 0	/* IN2 differential */
	>;
	cirrus,out-mono = <0 0 0 0 0 0>;
	cirrus,max-channels-clocked = <2 0 0>;
};
```

## Documentation/devicetree/bindings/input/cirrus,cs40l26.yaml
```yaml
# SPDX-License-Identifier: GPL-2.0-only OR BSD-2-Clause
%YAML 0.2
---
$id: http://devicetree.org/schemas/bindings/input/cs40l26.yaml#
$schema: http://devicetree.org/meta-schemas/core.yaml#

title: Cirrus Logic CS40L26 Boosted Haptic Amplifier

maintainers:
  - fred.treven@cirrus.com

description: |
  CS40L26 is a Boosted Haptic Driver with Integrated DSP and Waveform Memory
  with Advanced Closed Loop Algorithms and LRA protection

properties:
  compatible:
    enum:
      - cirrus,cs40l26a
      - cirrus,cs40l26b
      - cirrus,cs40l27a
      - cirrus,cs40l27b

  reg:
    maxItems: 1

  cirrus,vbbr-enable:
    type: boolean
    description:
      Enable VBST brownout prevention.

  cirrus,vbbr-thld-uv:
    $ref: /schemas/types.yaml#/definitions/uint32
    multipleOf: 55000
    minimum: 109000
    maximum: 3445000
    default: 273000
    description:
      Boost converter brownout prevention delta voltage threshold
      Brownout prevention mode is entered if the condition
      "VBST(target) - VBST(actual) <= VBBR_THLD" is met.

  cirrus,vbbr-max-att-db:
    $ref: /schemas/types.yaml#/definitions/uint32
    enum: [0, 1, 2, 3, 4, 5, 6, 7, 8, 9, 10, 11, 12, 13, 14, 15]
    default: 9
    description:
      Maximum attenuation that the reactive VBST brownout can apply to the
      signal.

  cirrus,vbbr-atk-step:
    $ref: /schemas/types.yaml#/definitions/uint32
    enum: [0, 1, 2, 3, 4, 5, 6, 7]
    default: 1
    description: |
      VBST brownout prevention attack step size. Configures the VBST brownout
      prevention attacking attenuation step size when operating in either
      digital volume or analog gain modes. The possible attack step values
      are relative to triggering VBBR_1/VBBR_2/VBBR_3:
      0: 0.0625 dB / 0.125 dB / 0.250 dB
      1: 0.125 dB / 0.250 dB / 0.500 dB
      2: 0.250 dB / 0.500 dB / 1.000 dB
      3: 0.500 dB / 1.000 dB / 2.000 dB
      4: 0.750 dB / 1.500 dB / 3.000 dB
      5: 1.000 dB / 2.000 dB / 4.000 dB
      6: 1.250 dB / 2.500 dB / 5.000 dB
      7: 1.500 dB / 3.000 dB / 6.000 dB

  cirrus,vbbr-atk-rate:
    $ref: /schemas/types.yaml#/definitions/uint32
    enum: [0, 1, 2, 3, 4, 5, 6, 7]
    default: 2
    description: |
      Attenuation attack step rate. Configures the amount of delay between
      consecutive volume attenuation steps when a brownout condition is
      present and the VBST brownout condition is in an attacking state:
      0: 2.5 us
      1: 5 us
      2: 10 us
      3: 25 us
      4: 50 us
      5: 100 us
      6: 250 us
      7: 500 us

  cirrus,vbbr-wait:
    $ref: /schemas/types.yaml#/definitions/uint32
    enum: [0, 1, 2, 3]
    default: 1
    description: |
      Configures the delay between a brownout condition no longer being
      present and the VBST brownout prevention entering an attenuation release
      state:
      0: 10 ms
      1: 100 ms
      2: 250 ms
      3: 500 ms

  cirrus,vbbr-rel-rate:
    $ref: /schemas/types.yaml#/definitions/uint32
    enum: [0, 1, 2, 3, 4, 5, 6, 7]
    default: 5
    description: |
      Attenuation release step rate. Configures the delay between consecutive
      volume attenuation release steps when a brownout condition is no longer
      present and the VBST brownout prevention is in an attenuation release
      state. The parameter can be set to 8 discrete values:
      0: 5 ms
      1: 10 ms
      2: 25 ms
      3: 50 ms
      4: 100 ms
      5: 250 ms
      6: 500 ms
      7: 1000 ms

  cirrus,vpbr-enable:
    type: boolean
    description:
      Enable VP brownout prevention.

  cirrus,vpbr-thld-uv:
    $ref: /schemas/types.yaml#/definitions/uint32
    multipleOf: 47000
    minimum: 2497000
    maximum: 3874000
    default: 2639000
    description:
      Battery voltage (VP) brownout prevention threshold.
      Brownout prevention mode is entered if VP falls below VPBR_THLD.

  cirrus,vpbr-max-att-db:
    $ref: /schemas/types.yaml#/definitions/uint32
    enum: [0, 1, 2, 3, 4, 5, 6, 7, 8, 9, 10, 11, 12, 13, 14, 15]
    default: 9
    description:
      Maximum attenuation that the VP brownout prevention can apply to the
      signal.

  cirrus,vpbr-atk-step:
    $ref: /schemas/types.yaml#/definitions/uint32
    enum: [0, 1, 2, 3, 4, 5, 6, 7]
    default: 1
    description: |
      VP brownout prevention attack step size. Configures the VP brownout
      prevention attacking attenuation step size when operating in either
      digital volume or analog gain modes. There are 8 possible attack step
      values; they are relative to triggering VPBR_1/VPBR_2/VPBR_3.
      0: 0.0625 dB / 0.125 dB / 0.250 dB
      1: 0.125 dB / 0.250 dB / 0.500 dB (default)
      2: 0.250 dB / 0.500 dB / 1.000 dB
      3: 0.500 dB / 1.000 dB / 2.000 dB
      4: 0.750 dB / 1.500 dB / 3.000 dB
      5: 1.000 dB / 2.000 dB / 4.000 dB
      6: 1.250 dB / 2.500 dB / 5.000 dB
      7: 1.500 dB / 3.000 dB / 6.000 dB
    minimum: 0x0
    maximum: 0x7
    default: 0x1

  cirrus,vpbr-atk-rate:
    $ref: /schemas/types.yaml#/definitions/uint32
    enum: [0, 1, 2, 3, 4, 5, 6, 7]
    default: 2
    description: |
      Attenuation attack step rate. Configures the amount of delay between
      consecutive volume attenuation steps when a brownout condition is
      present and the VP brownout condition is in an attacking state:
      0: 2.5 us
      1: 5 us
      2: 10 us
      3: 25 us
      4: 50 us
      5: 100 us
      6: 250 us
      7: 500 us

  cirrus,vpbr-wait:
    $ref: /schemas/types.yaml#/definitions/uint32
    enum: [0, 1, 2, 3]
    default: 1
    description: |
      Configures the delay between a brownout condition no longer being
      present and the VP brownout prevention entering an attenuation release
      state:
      0: 10 ms
      1: 100 ms
      2: 250 ms
      3: 500 ms

  cirrus,vpbr-rel-rate:
    $ref: /schemas/types.yaml#/definitions/uint32
    enum: [0, 1, 2, 3, 4, 5, 6, 7]
    default: 5
    description: |
      Attenuation release step rate. Configures the delay between consecutive
      volume attenuation release steps when a brownout condition is no longer
      present and the VP brownout prevention is in an attenuation release
      state:
      0: 5 ms
      1: 10 ms
      2: 25 ms
      3: 50 ms
      4: 100 ms
      5: 250 ms
      6: 500 ms
      7: 1000 ms

  cirrus,bst-dcm-en:
    description:
      Boost converter automatic DCM Mode enable. This enables the digital
      boost converter to operate in a low power (DCM) mode during low loading
      conditions.
      0 = Boost converter automatic low power mode disabled (DISABLED)
      1 = Boost converter automatic low power mode enabled  (ENABLED)
    type: boolean

  cirrus,bst-ipk-microamp:
    description:
      Maximum amount of current that can be drawn by the device's boost
      converter in uA. Accepted values are between 800000 uA and 4800000 uA in
      50000 uA increments.
    $ref: "/schemas/types.yaml#/definitions/uint32"
    minimum: 800000
    maximum: 4800000
    default: 4500000

  cirrus,bst-ctl-microvolt:
    description:
      Maximum target voltage to which the class H algorithm may increase the
      VBST supply, expressed in uV. Valid values range from 2550000 uV to
      11000000 uV (inclusive) in steps of 50000 uV. If this value is specified as
      zero or VP rises above this value, VBST is bypassed to VP. If this value
      is omitted, the maximum target voltage remains at 11 V.
    $ref: "/schemas/types.yaml#/definitions/uint32"
    minimum: 2550000
    maximum: 11000000
    default: 11000000

  cirrus,f0-default:
    description:
      Default LRA resonant frequency (f0), expressed as follows
      cirrus,f0-default = f0 (Hz) * 2^14.
      This value represents the frequency used during playback of PWLE segments
      specified with frequency equal to f0; it also serves as the unit-specific
      f0 input to the click compensation algorithm. It can be overwritten at a
      later time by writing to the f0_stored sysfs control.
    $ref: "/schemas/types.yaml#/definitions/uint32"
    minimum: 819200
    maximum: 8372224
    default: 2621440

  cirrus,redc-default:
    description:
      Default LRA series resistance (ReDC), expressed as follows
      cirrus,redc-default = ReDC (ohms) * 2^15.
      This value represents the unit-specific ReDC input to the click compensation
      algorithm. It can be overwritten at a later time by writing to the redc_stored
      sysfs control.
    $ref: "/schemas/types.yaml#/definitions/uint32"
    minimum: 0
    maximum: 16777215
    default: 340787

  cirrus,q-default:
    description:
      Default LRA Q factor (silicon revision B1 only), expressed as follows
      cirrus,q-default = Q * 2^16.
      This value represents the unit-specific Q factor used to select the correct
      sub-waveform for Q-dependent wavetable indexes. It can be overwritten at a
      later time by writing to the q_stored sysfs control. If this value is omitted
      or specified as zero, a default value of 27 is used.
    $ref: "/schemas/types.yaml#/definitions/uint32"
    minimum: 0
    maximum: 8388607
    default: 1769472

  cirrus,asp-gain-scale-pct:
    description:
      Scaling applied to gain for ASP streaming if present and less or equal to
      100.
      The value given is in percent between 0 - 100 with 100 being full scale
      and 0 being mute.
    $ref: "/schemas/types.yaml#/definitions/uint32"
    minimum: 0
    maximum: 100
    default: 100

  svc-le:
    description:
      Range of LE values, defined by "cirrus,min" and "cirrus,max" in Henries
      using Q0.23 number format, that determines which SVC and Wavetable tuning
      files should be loaded by the driver. The files must be named
      "cs40l26-svcX.bin" for SVC tunings and "cs40l26-wtX.bin" for wavetables,
      where 'X' corresponds to the value given to "cirrus,index".
      The optional property "cirrus,gain-adjust" is used to alter the global
      digital gain based on which LRA is being used. This value has a range of
      -100 to +100 and will change the digital gain percentage by this amount.
      Note that the full gain value must still be valid, the maximum is 100% and
      the minimum is 0%.
      If the LE value found for the attached LRA does not match a provided
      range, or if these properties are omitted/malformed, the default tunings
      ("cs40l26-svc.bin" and "cs40l26.bin") will be loaded.
      See examples section for how to use these controls.

  cirrus,pm-active-timeout-ms:
    description:
      Time (in milliseconds) it takes for the DSP to transition from active
      mode to standby mode.
    $ref: "/schemas/type.yaml#/definitions/uint32"
    minimum: 100
    maximum: 10000
    default: 250

  cirrus,pm-stdby-timeout-ms:
    description:
      Time (in milliseconds) it takes for the DSP to transition from standby
      mode to hibernate mode.
    $ref: "/schemas/type.yaml#/definitions/uint32"
    minimum: 100
    maximum: 10000
    default: 100

  cirrus,bst-expl-mode-disable:
    description:
      Disable boost exploratory mode if this boolean is present in the
      devicetree. Boost exploratory mode allows the device to overshoot
      the set peak current limit. This has potential to damage the boost
      inductor. Disabling this mode will prevent this from happening; it will
      also prevent the device from detecting boost inductor short errors.
      (Default) Enabled
    type: boolean

 cirrus,dbc-enable:
    description:
      If present, Dynamic Boost Control will be enabled automatically after
      firmware is loaded.
      (Default) Disabled
    type: boolean

  cirrus,dbc-env-rel-coef:
    description:
      Envelope release time represented as a scaling coefficient; Q0.23 format.
      See Cirrus Logic release notes for more information on how to program
      this parameter. Maximum is 1 second, default is 999.5 ms.
    $ref: "/schemas/type.yaml#/definitions/uint32"
    minimum: 0
    maximum: 8388607
    default: 8384414

  cirrus,dbc-fall-headroom:
    description:
      Headroom for falling envelope in Dynamic Boost Control. Value is a ratio
      of full-scale (12.3 V) and is in Q0.23 format. To program a headroom of x
      Volts, the following formula is used. (x/12.3) * 2^(23). Maximum is 12.3
      V, default is 1.1 V.
    $ref: "/schemas/type.yaml#/definitions/uint32"
    minimum: 0
    maximum: 8388607
    default: 750193

  cirrus,dbc-rise-headroom:
    description:
      Headroom for rising envelope in Dynamic Boost Control. Value is a ratio
      of full-scale (12.3 V) and is in Q0.23 format. To program a headroom of x
      Volts, the following formula is used. (x/12.3) * 2^(23). Maximum is 12.3
      V, default is 2.1 V.
    $ref: "/schemas/type.yaml#/definitions/uint32"
    minimum: 0
    maximum: 8388607
    default: 1432204

  cirrus,dbc-tx-lvl-hold-off-ms:
    description:
      Amount of time that the input signal must be lower than the threshold
      (TX_LVL_THRESH, programmed via dbc-tx-lvl-thresh-fs). The algorithm
      registers this as silence. The signal rising back to the threshold will
      trigger an immediate rise to the max boost level.
      The value is provided in milliseconds with a maximum of 1 second.
    $ref: "/schemas/type.yaml#/definitions/uint32"
    minimum: 0
    maximum: 1000
    default: 10

  cirrus,dbc-tx-lvl-thresh-fs:
    description:
      Full-scale threshold used by the rise edge detector in the Dynamic Boost
      Control algorithm. When silence is detected and the signal rises above
      this threshold an immediate rise to the max boost level is triggered.
      The value must be provided as a percentage of full scale and is in Q0.23
      format. To program a threshold of x dBFs use the following formula.
      10^(x/20) * 2^(23). Default value is -80 dBFs.
    $ref: "/schemas/type.yaml#/definitions/uint32"
    minimum: 0
    maximum: 8388607
    default: 839

  cirrus,pwle-zero-cross-en:
    description:
      Boolean to ensure that PWLE waveforms always end on a zero crossing,
      extending the length of the waveform if necessary.
      (Default) Disabled
    type: boolean

  cirrus,calib-fw:
    description:
      Boolean to load calibration firmware ("cs40l26-calib.wmfw")
      instead of runtime firmware at boot time. Allows user to avoid
      using the swap_firmware sysfs control to load calibration firmware.
      (Default) Runtime firmware loaded at boot
    type: boolean

cirrus,fw-defer:
    description:
      Boolean to probe and register the driver without loading RAM firmware.
      This puts the driver in a partially usable state.
      To gain full functionality, write the designated values for
      runtime (0) or calibration (1) firmware to the swap_firmware
      sysfs control.
      (Default) Firmware is loaded when driver probes
    type: boolean

cirrus,no-wait-ram-indices:
    description:
      List of RAM indices that will not use the delay_before_stop_playback_us
      prior to sending a STOP_PLAYBACK command.

cirrus,release-index:
  $ref: /schemas/types.yaml#/definitions/uint32-array
  items:
    description: Waveform BANK (RAM = 0, ROM = 1)
    description: Waveform offset from bank base
  description: >
      Bank and index of effect to be mapped to GPI release event upon driver
      probe.

cirrus,press-index:
  $ref: /schemas/types.yaml#/definitions/uint32-array
  items:
    description: Waveform BANK (RAM = 0, ROM = 1)
    description: Waveform offset from bank base
  description: >
      Bank and index of effect to be mapped to GPI press event upon driver
      probe.

cirrus,clip-lvl-microvolt:
    description:
      Input clipping level after Virtual Impedance correction expressed in uV.
      Must be given in increments of 250000 uV.
    $ref: "/schemas/types.yaml#/definitions/uint32"
    minimum: 250000
    maximum: 11000000
    default: 11000000

required:
  - compatible

unevaluatedProperties: false

examples:
  - |

  &i2c0 {
    cs40l26: cs40l26@58 {
      compatible = "cirrus,cs40l26";
      reg = <0x58>;
      interrupt-parent = <&gpio0>;
      interrupts = <57 8>;
      reset-gpios = <&gpio0 54 0>;
      VA-supply = <&dummy_vreg>;
      VP-supply = <&dummy_vreg>;

      cirrus,vbbr-enable;
      cirrus,vbbr-thld-uv = <300000>;
      cirrus,vpbr-enable;
      cirrus,vpbr-thld-uv = <2592000>;

      cirrus,dbc-enable;
      cirrus,dbc-env-rel-coef = <8377777>; // 16 ms
      cirrus,dbc-fall-headroom = <750000>; // 1.09 V
      cirrus,dbc-rise-headroom = <1400000>; // 2.05 V
      cirrus,dbc-tx-lvl-hold-off-ms = <50>; // 50 ms
      cirrus,dbc-tx-lvl-thresh-fs = <800>; // -80.4 dBFs

      cirrus,asp-gain-scale-pct = <30>;

      cirrus,no-wait-ram-indices = <5 10 25>;

      cirrus,release-index = <0 1>; // RAM bank, index 1
      cirrus,press-index = <1 2>; // ROM bank, index 2

      svc-le1 {
        cirrus,min = <500>; //59.6 uH
        cirrus,max = <750>; //89.4 uH
        cirrus,index = <1>;
        cirrus,gain-adjust = "-5";
      };
      svc-le2 {
        cirrus,min = <1000>; //119.2 uH
        cirrus,max = <1500>; //178.8 uH
        cirrus,index = <2>;
        cirrus,gain-adjust = "10";
      };
      svc-le3 {
        cirrus,min = <2000>; //238.4 uH
        cirrus,max = <2400>; //286.1 uH
        cirrus,index = <3>;
        cirrus,gain-adjust = "20";
      };
    };
};
```

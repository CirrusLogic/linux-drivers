## drivers/firmware/cirrus/Kconfig
```kconfig
# SPDX-License-Identifier: GPL-2.0-only

config FW_CS_DSP
	tristate
	default n

config FW_CS_DSP_KUNIT_TEST_UTILS
	tristate

config FW_CS_DSP_KUNIT_TEST
	tristate "KUnit tests for Cirrus Logic cs_dsp" if !KUNIT_ALL_TESTS
	depends on KUNIT && REGMAP && FW_CS_DSP
	default KUNIT_ALL_TESTS
	select FW_CS_DSP_KUNIT_TEST_UTILS
	help
	  This builds KUnit tests for cs_dsp.
	  For more information on KUnit and unit tests in general,
	  please refer to the KUnit documentation in
	  Documentation/dev-tools/kunit/.
	  If in doubt, say "N".

config FW_CL_DSP
	tristate
	default n

menu "CL_DSP Firmware Driver"
	depends on FW_CL_DSP

config FW_CL_DSP_MAX_TRANSMISSION_LENGTH
	int "Max Transmission Length"
	default 4096
	range 128 4096
	help
	  Maximum write length in bytes per I2C/SPI
	  transaction. Use to limit length of blocking
	  writes in case of control port contention.

endmenu
```
